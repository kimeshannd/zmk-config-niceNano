## config/boards/shields/corne/Kconfig.defconfig
```kconfig
# Copyright (c) 2020 The ZMK Contributors
# SPDX-License-Identifier: MIT

if SHIELD_CORNE_DONGLE

config ZMK_KEYBOARD_NAME
    default "Corne"
	
config ZMK_SPLIT_ROLE_CENTRAL
    default y
	
config ZMK_USB
	default y

endif

if SHIELD_CORNE_LEFT || SHIELD_CORNE_RIGHT || SHIELD_CORNE_DONGLE 

config ZMK_SPLIT
	default y

if ZMK_DISPLAY

config I2C
    default y

config SSD1306
    default y

endif # ZMK_DISPLAY

config ZMK_BLE
	default y
	
endif
```
